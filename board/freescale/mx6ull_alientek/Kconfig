## board/freescale/mx6ull_alientek/Kconfig
```kconfig
if TARGET_MX6ULL_ALIENTEK

config SYS_BOARD
	default "mx6ull_alientek"

config SYS_VENDOR
	default "freescale"

config SYS_CONFIG_NAME
	default "mx6ull_alientek"

config IMX_CONFIG
	default "board/freescale/mx6ull_alientek/imximage.cfg"

endif
```
